## configs/ballometer_defconfig
```kconfig
BR2_aarch64=y
BR2_cortex_a53=y
BR2_ARM_FPU_VFPV4=y

BR2_TOOLCHAIN_BUILDROOT_CXX=y

BR2_SYSTEM_DHCP="eth0"

# Linux headers same as kernel, a 5.4 series
BR2_PACKAGE_HOST_LINUX_HEADERS_CUSTOM_5_4=y

BR2_TOOLCHAIN_BUILDROOT_WCHAR=y

BR2_TARGET_GENERIC_ROOT_PASSWD="hello"

BR2_ROOTFS_OVERLAY="board/ballometer/overlay"
BR2_ROOTFS_POST_BUILD_SCRIPT="board/ballometer/post-build.sh"
BR2_ROOTFS_POST_IMAGE_SCRIPT="board/ballometer/post-image.sh"

BR2_LINUX_KERNEL=y
BR2_LINUX_KERNEL_CUSTOM_TARBALL=y
BR2_LINUX_KERNEL_CUSTOM_TARBALL_LOCATION="$(call github,raspberrypi,linux,1c64f4bc22811d2d371b271daa3fb27895a8abdd)/linux-1c64f4bc22811d2d371b271daa3fb27895a8abdd.tar.gz"
BR2_LINUX_KERNEL_DEFCONFIG="bcmrpi3"

# Build the DTB from the kernel sources
BR2_LINUX_KERNEL_DTS_SUPPORT=y
BR2_LINUX_KERNEL_INTREE_DTS_NAME="broadcom/bcm2710-rpi-3-b broadcom/bcm2710-rpi-3-b-plus broadcom/bcm2837-rpi-3-b"

BR2_LINUX_KERNEL_NEEDS_HOST_OPENSSL=y
BR2_PACKAGE_GIT=y
BR2_PACKAGE_E2FSPROGS=y
BR2_PACKAGE_E2FSPROGS_RESIZE2FS=y
BR2_PACKAGE_RPI_BT_FIRMWARE=y
BR2_PACKAGE_RPI_FIRMWARE=y
BR2_PACKAGE_RPI_WIFI_FIRMWARE=y
BR2_PACKAGE_NODEJS=y
BR2_PACKAGE_NODEJS_MODULES_ADDITIONAL="tileserver-gl-light"
BR2_PACKAGE_PYTHON3=y
#BR2_PACKAGE_PYTHON_ADAFRUIT_CIRCUITPYTHON_BMP280=y
#BR2_PACKAGE_PYTHON_ADAFRUIT_CIRCUITPYTHON_GPS=y
#BR2_PACKAGE_PYTHON_ADAFRUIT_CIRCUITPYTHON_LSM303_ACCEL=y
#BR2_PACKAGE_PYTHON_ADAFRUIT_CIRCUITPYTHON_LSM303DLH_MAG=y
#BR2_PACKAGE_PYTHON_ADAFRUIT_CIRCUITPYTHON_SHT31D=y
#BR2_PACKAGE_PYTHON_ADAFRUIT_CIRCUITPYTHON_TSL2591=y
BR2_PACKAGE_PYTHON_ALSAAUDIO=y
BR2_PACKAGE_PYTHON_INFLUXDB=y
BR2_PACKAGE_PYTHON_PYNMEA2=y
BR2_PACKAGE_PYTHON_RPI_GPIO=y
BR2_PACKAGE_PYTHON_RPLCD=y
BR2_PACKAGE_PYTHON_SMBUS2=y
BR2_PACKAGE_PYTHON_STATEMACHINE=y
BR2_PACKAGE_CA_CERTIFICATES=y
#BR2_PACKAGE_INFLUXDB=y
BR2_PACKAGE_LIBCURL=y
BR2_PACKAGE_BLUEZ_TOOLS=y
BR2_PACKAGE_BLUEZ5_UTILS=y
BR2_PACKAGE_BLUEZ5_UTILS_CLIENT=y
BR2_PACKAGE_BLUEZ5_UTILS_DEPRECATED=y
BR2_PACKAGE_DHCPCD=y
BR2_PACKAGE_NTP=y
BR2_PACKAGE_OPENSSH=y
BR2_PACKAGE_WPA_SUPPLICANT=y
BR2_PACKAGE_WPA_SUPPLICANT_AUTOSCAN=y
BR2_PACKAGE_WPA_SUPPLICANT_CLI=y
BR2_PACKAGE_WPA_SUPPLICANT_WPA_CLIENT_SO=y
BR2_PACKAGE_ZSH=y

# Required tools to create the SD image
BR2_PACKAGE_HOST_DOSFSTOOLS=y
BR2_PACKAGE_HOST_GENIMAGE=y
BR2_PACKAGE_HOST_MTOOLS=y

BR2_PACKAGE_HOST_PYTHON3=y
BR2_PACKAGE_HOST_PYTHON3_SSL=y

# Filesystem / image
BR2_TARGET_ROOTFS_EXT2=y
BR2_TARGET_ROOTFS_EXT2_4=y
BR2_TARGET_ROOTFS_EXT2_SIZE="300M"
# BR2_TARGET_ROOTFS_TAR is not set

BR2_ROOTFS_POST_SCRIPT_ARGS="--aarch64"
```

## configs/ballometer_raspberrypi3_defconfig
```kconfig
BR2_arm=y
BR2_cortex_a53=y
BR2_ARM_FPU_NEON_VFPV4=y
BR2_PACKAGE_HOST_LINUX_HEADERS_CUSTOM_5_4=y
BR2_TOOLCHAIN_BUILDROOT_WCHAR=y
BR2_TOOLCHAIN_BUILDROOT_CXX=y
BR2_TARGET_GENERIC_ROOT_PASSWD="hello"
BR2_SYSTEM_DHCP="eth0"
BR2_ROOTFS_POST_BUILD_SCRIPT="board/ballometer/post-build.sh"
BR2_ROOTFS_POST_IMAGE_SCRIPT="board/ballometer/post-image.sh"
BR2_ROOTFS_POST_SCRIPT_ARGS="--add-miniuart-bt-overlay"
BR2_LINUX_KERNEL=y
BR2_LINUX_KERNEL_CUSTOM_TARBALL=y
BR2_LINUX_KERNEL_CUSTOM_TARBALL_LOCATION="$(call github,raspberrypi,linux,1c64f4bc22811d2d371b271daa3fb27895a8abdd)/linux-1c64f4bc22811d2d371b271daa3fb27895a8abdd.tar.gz"
BR2_LINUX_KERNEL_DEFCONFIG="bcm2709"
BR2_LINUX_KERNEL_DTS_SUPPORT=y
BR2_LINUX_KERNEL_INTREE_DTS_NAME="bcm2710-rpi-3-b bcm2710-rpi-3-b-plus bcm2710-rpi-cm3"
BR2_LINUX_KERNEL_NEEDS_HOST_OPENSSL=y
BR2_PACKAGE_GIT=y
BR2_PACKAGE_RPI_FIRMWARE=y
BR2_PACKAGE_RPI_WIFI_FIRMWARE=y
BR2_PACKAGE_NODEJS=y
BR2_PACKAGE_NODEJS_MODULES_ADDITIONAL="tileserver-gl-light"
BR2_PACKAGE_PYTHON3=y
BR2_PACKAGE_PYTHON_ADAFRUIT_CIRCUITPYTHON_BMP280=y
BR2_PACKAGE_PYTHON_ADAFRUIT_CIRCUITPYTHON_GPS=y
BR2_PACKAGE_PYTHON_ADAFRUIT_CIRCUITPYTHON_LSM303_ACCEL=y
BR2_PACKAGE_PYTHON_ADAFRUIT_CIRCUITPYTHON_LSM303DLH_MAG=y
BR2_PACKAGE_PYTHON_ADAFRUIT_CIRCUITPYTHON_SHT31D=y
BR2_PACKAGE_PYTHON_ADAFRUIT_CIRCUITPYTHON_TSL2591=y
BR2_PACKAGE_PYTHON_RPI_GPIO=y
BR2_PACKAGE_PYTHON_RPLCD=y
BR2_PACKAGE_PYTHON_STATEMACHINE=y
BR2_PACKAGE_CA_CERTIFICATES=y
BR2_PACKAGE_LIBCURL=y
BR2_PACKAGE_DHCPCD=y
BR2_PACKAGE_NTP=y
BR2_PACKAGE_OPENSSH=y
BR2_PACKAGE_WPA_SUPPLICANT=y
BR2_PACKAGE_WPA_SUPPLICANT_AUTOSCAN=y
BR2_PACKAGE_WPA_SUPPLICANT_CLI=y
BR2_PACKAGE_WPA_SUPPLICANT_WPA_CLIENT_SO=y
BR2_PACKAGE_ZSH=y
BR2_TARGET_ROOTFS_EXT2=y
BR2_TARGET_ROOTFS_EXT2_4=y
BR2_TARGET_ROOTFS_EXT2_SIZE="200M"
# BR2_TARGET_ROOTFS_TAR is not set
BR2_PACKAGE_HOST_DOSFSTOOLS=y
BR2_PACKAGE_HOST_GENEXT2FS=y
BR2_PACKAGE_HOST_GENIMAGE=y
BR2_PACKAGE_HOST_MTOOLS=y
BR2_PACKAGE_HOST_PYTHON3=y
BR2_PACKAGE_HOST_PYTHON3_SSL=y
```

## package/ballometer-update/Config.in
```kconfig
config BR2_PACKAGE_BALLOMETER_UPDATE
    bool "ballometer_update"
    help
        Full system update with dual partition boot on the ballometer.
```

## package/ballometer/Config.in
```kconfig
config BR2_PACKAGE_BALLOMETER
    bool "ballometer"
    help
        The ballometer is a sensor box for hot air balloons. 
```

## package/local-ui/Config.in
```kconfig
config BR2_PACKAGE_LOCAL_UI
    bool "local-ui"
    help
        Web frontend for the local deployment of the ballometer. 
```

## package/python-pyftdi/Config.in
```kconfig
config BR2_PACKAGE_PYTHON_PYFTDI
	bool "python-pyftdi"
	select BR2_PACKAGE_PYTHON_PYUSB # runtime
	select BR2_PACKAGE_PYTHON_PYSERIAL # runtime
	help
	  FTDI device driver (pure Python).

	  http://github.com/eblot/pyftdi
```

## package/python-pyusb/Config.in
```kconfig
config BR2_PACKAGE_PYTHON_PYUSB
	bool "python-pyusb"
	help
	  Python USB access module.

	  http://walac.github.io/pyusb
```

## package/python-rpi-gpio-64/Config.in
```kconfig
config BR2_PACKAGE_PYTHON_RPI_GPIO_64
	bool "python-rpi-gpio-64"
	# depends on BR2_arm
	help
	  A Python module to control the GPIO on a Raspberry Pi.

	  http://sourceforge.net/p/raspberry-gpio-python
```

## package/python-setuptools-scm/Config.in
```kconfig
config BR2_PACKAGE_PYTHON_SETUPTOOLS_SCM
	bool "python-setuptools-scm"
	help
	  setuptools_scm handles managing your Python package versions in SCM metadata instead of declaring them as the version argument or in a SCM managed file.

	  https://pypi.org/project/setuptools-scm/
```
